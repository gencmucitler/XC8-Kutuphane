/**********************************************************
*  Yazar 	: sigmoid
*  Web 		: http://www.gencmucitler.com
*  Ýlk		: Ekim 2017
*  Düzenleme: Yok 
*  Versiyon : 0.1
*  Açýklama : Nokia 5110 Kütüphanesi (pcd8544)
***********************************************************/

#include "nokia5110.h"
char lcd_kontrast=0xB1; //lcd kontrastý B1 ile BF arasýnda ayarlayýnýzç

/*******************************************************************************
 *  LCD ekran için karakter tanýmlamalarý. Standart Font                       *
 *******************************************************************************/
const char harftablo[] ={0x00, 0x00, 0x00, 0x00, 0x00, // SPACE  0
                         0x00, 0x00, 0x5F, 0x00, 0x00, // !	1
                         0x00, 0x03, 0x00, 0x03, 0x00, // "	2
                         0x14, 0x3E, 0x14, 0x3E, 0x14, // #	3
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			 0x24, 0x2A, 0x6A, 0x2A, 0x10};// þ 254	106

const char  rakamtablo[]  =  //12*16
{
0x00, 0x00, 0x00, 0x80, 0x80, 0x80, 0x80, 0x80, 0x80, 0x00, 0x00, 0x00, 0x00, 0x00, 0x01, 0x03, 0x03, 0x03, 0x03, 0x03, 0x03, 0x01, 0x00, 0x00,   // -
0x00, 0x00, 0x00, 0x00, 0x00, 0x00, 0x00, 0x00, 0x00, 0x00, 0x00, 0x00, 0x00, 0x00, 0x00, 0x00, 0x00, 0xc0, 0xc0, 0x00, 0x00, 0x00, 0x00, 0x00,   // .
0x00, 0x00, 0x02, 0x86, 0x86, 0x86, 0x86, 0x86, 0x86, 0x02, 0x00, 0x00, 0x00, 0x00, 0x81, 0xc3, 0xc3, 0xc3, 0xc3, 0xc3, 0xc3, 0x81, 0x00, 0x00,   // /
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0x00, 0xfc, 0x7a, 0x86, 0x86, 0x86, 0x86, 0x86, 0x86, 0x7a, 0xfc, 0x00, 0x00, 0x00, 0x81, 0xc3, 0xc3, 0xc3, 0xc3, 0xc3, 0xc3, 0xbd, 0x7e, 0x00   // 9
};

const char  rakamtablo2[]=  //14*24
{
0x00, 0x00, 0x00, 0x00, 0x00, 0x00, 0x00, 0x00, 0x00, 0x00, 0x00, 0x00,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 0x00,   // -
0x00, 0x00, 0x00, 0x00, 0x00, 0x00, 0x00, 0x00, 0x00, 0x00, 0x00, 0x00,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 0x00,   // .
0x00, 0x00, 0x02, 0x06, 0x0e, 0x0e, 0x0e, 0x0e, 0x0e, 0x0e, 0x06, 0x02,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 0x00,   // /
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0x00, 0xfc, 0xfa, 0xf6, 0x0e, 0x0e, 0x0e, 0x0e, 0x0e, 0x0e, 0xf6, 0xfa,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 0x7f, 0x00   // 9
};

/*******************************************************************************
 *  LCD ekraný çalýþtýrýr. Ýlk önce bu fonksiyon çalýþtýrýlmalýdýr.             *
 *******************************************************************************/
void lcd_baslat(void) {    
    LCD_CE_TRIS = 0;    //çýkýþ olarak tanýmla
    LCD_CLK_TRIS = 0;
    LCD_DATA_TRIS = 0;
    LCD_DC_TRIS = 0;
    LCD_RST_TRIS = 0;
    
    LCD_DATA=0;
    LCD_CLK=0;
    LCD_DC=0;
    
    //Lcd ekraný resetle
    LCD_RST=0;    
    LCD_RST=1;
    
    LCD_DC=0;   //KOMUT setini seç
    lcd_veriyaz(0x21);              //chip aktif, yatay adresleme, uzatýlmýþ komut seti
    lcd_veriyaz(lcd_kontrast);      //LCD kontrastý düþük olarak ayarla.
    lcd_veriyaz(0x04);              //Temp coefficent ayarý
    lcd_veriyaz(0x14);              //LCD bias mode 1:48: Try 0x13 or 0x14
    lcd_veriyaz(0x20);              //temel komut seti
    lcd_veriyaz(0x0C);              //normal mode aktif     
}

/*******************************************************************************
 * Ýstenilen pozisyona gider.                                                   *
 * Örnek: lcd_git(2,5);                                                         *
 *******************************************************************************/
void lcd_git(char satir, char sutun)
{
    LCD_DC=0;
    lcd_veriyaz(0x40 | satir);
    lcd_veriyaz(0x80 | (sutun*6));
}

/*******************************************************************************
 * Ýstenilen poziyonda ekrana yazý yazar.                                       *
 * Örnek : lcd_mesajyaz(1,4,"Deneme");                                          *
 *******************************************************************************/
void lcd_mesajyaz(char satir, char sutun, const char *mesaj)
{
    lcd_git(satir, sutun);
    do {
        lcd_harfyaz(*mesaj++);
    } while (*mesaj);
}

/*******************************************************************************
 * Lcd ekrana en son kaldýðý pozisyondan itibaren yazý yazar.                   *
 * Örnek : lcd_mesajyaz_cp("deneme");                                           *
 *******************************************************************************/
void lcd_mesajyaz_cp(const char *mesaj) {
    do {
        lcd_harfyaz(*mesaj++);
    } while (*mesaj);
}

/*******************************************************************************
 * Lcd ekrana tek bir harf yazar.                                               *
 * Örnek : lcd_harfyaz('A');                                                    *
 *******************************************************************************/
void lcd_harfyaz(char harf) 
{
    unsigned int adres;
    LCD_DC=1;   //veri modu
   
    switch(harf)
	{
		case 'Ç':   //türkçe karakterler için adres bilgisini yeniden tanýmla
			adres=475;
			break;
		case 'Ð':
			adres=480;
			break;
		case 'Ö':
			adres=485;
			break;
		case 'Ü':
			adres=490;
			break;
		case 'Ý':
			adres=495;
			break;			
		case 'Þ':
			adres=500;
			break;
		case 'ç':
			adres=505;
			break;
		case 'ð':
			adres=510;
			break;
		case 'ö':
			adres=515;
			break;
		case 'ü':
			adres=520;		
			break;	
		case 'ý':
			adres=525;
			break;					
		case 'þ':
			adres=530;
			break;
		default:
			adres=(harf-' ')*5;   //ASCII Tablosuna göre space karakteri 
                                  //tablonun ilk karakteri
			break;			
	}	

	lcd_veriyaz(harftablo[adres++]);
	lcd_veriyaz(harftablo[adres++]);
	lcd_veriyaz(harftablo[adres++]);
	lcd_veriyaz(harftablo[adres++]);
	lcd_veriyaz(harftablo[adres++]);
    lcd_veriyaz( 0x00); //boþluk ekle
}

/*******************************************************************************
 * Lcd ekraný tamamen siler                                                    *
 *******************************************************************************/
void lcd_sil()
{
    int i;
    lcd_git(0,0);
 
    LCD_DC=1;
    for(i=0;i<504;i++)
    {
        lcd_veriyaz(0x00);  //tüm ekraný boþlukla doldur.
    }
   
    lcd_git(0,0);
}

/*******************************************************************************
 * Lcd ekranda istenilen satýrý siler.                                         *
 *******************************************************************************/
void lcd_satirsil(char satir)
{
     char i;
    lcd_git(satir,0);
 
    LCD_DC=1;
    for(i=0;i<84;i++)
    {
        lcd_veriyaz(0x00);  //tüm ekraný boþlukla doldur.
    }
   
    lcd_git(satir,0);   
}

/*******************************************************************************
 * Lcd ekran kontrastýný artýrýr     .                                         *
 *******************************************************************************/
void lcd_kontrast_artir(void)
{
//  b1 ile bf arasýnda deðiþsin.
//    LCD_DC=0;   //KOMUT setini seç
//    lcd_veriyaz(0x21);              //chip aktif, yatay adresleme, uzatýlmýþ komut seti
//    lcd_veriyaz(lcd_kontrast++);
    lcd_veriyaz(0x20);              //temel komut seti
}

/*******************************************************************************
 * Lcd ekran kontrastýný azaltýr                                               *
 *******************************************************************************/
void lcd_kontrast_azalt(void)
{
//    LCD_DC=0;   //KOMUT setini seç
//    lcd_veriyaz(0x21);              //chip aktif, yatay adresleme, uzatýlmýþ komut seti
//    lcd_veriyaz(lcd_kontrast--);
 //   lcd_veriyaz(0x20);              //temel komut seti
}

/*******************************************************************************
 * Lcd ekrandaki grafikleri ters gösterir.                                     *
 *******************************************************************************/
void lcd_ekrani_tersle(void)
{
    LCD_DC=0;
    lcd_veriyaz(0x0D);              //inverse video mode aktif
    
}

/*******************************************************************************
 * Lcd ekran normal mode çalýþtýr                                              *
 *******************************************************************************/
void lcd_normalmode(void)
{
    LCD_DC=0;
    lcd_veriyaz(0x0C);              //normal video mode aktif
}



/*******************************************************************************
 * Lcd ekrana 1 bytelýk veriyi göderir.                                        *
 *******************************************************************************/
void lcd_veriyaz(char veri)
{
    char i;
    
    LCD_CE=0;   //lcd yi seç
    
    for(i=0;i<8;i++)
    {
        veri=veri<<1;   //ilk önce MSB gönderilir.
        LCD_DATA=CARRY;
        LCD_CLK=1;
        __delay_us(1);
        LCD_CLK=0;
    }
    
    LCD_CE=1;
}

/*******************************************************************************
 * Lcd ekrana resim çizer.                                                      *
 *******************************************************************************/
void lcd_resimciz(char satir,char sutun,const char *resim)
{
    
}

/*******************************************************************************
 * Lcd ekrana dijital sayý yazar.                                              *
 *******************************************************************************/
void lcd_sayiyaz(char satir, char sutun,char* sayi,char font)
{
    char * sayi_t;
    char siramax,sira,i;
    char rakam;
    unsigned int adres;
    
    if(font==NORMAL)
        siramax=2; //dikeyde 2 sýra
    else
        siramax=3; //dikeyde 3 sýra

    for(sira=0;sira<siramax;sira++)
    {
        
        lcd_git(satir+sira,sutun);
        sayi_t=sayi;

        do {
            
            LCD_DC = 1; //veri modu  
            rakam=*sayi_t++;
            
            if (font == NORMAL) 
            {
                if (sira == 0)
                    adres = (rakam - '-')*24;
                else
                    adres = (rakam - '-')*24 + 12;

                for (i = 0; i < 12; i++) {
                    lcd_veriyaz(rakamtablo[adres++]);
                }
            }
            else
            {                
                if (sira == 0)
                    adres = (rakam - '-')*42;
                else if (sira == 1)
                    adres = (rakam - '-')*42 + 14;
                else
                    adres = (rakam - '-')*42 + 28;

                for (i = 0; i < 14; i++) {
                    lcd_veriyaz(rakamtablo2[adres++]);
                }
            }


        } while (*sayi_t);
    }    

}
    

/*******************************************************************************
 * printf fonksiyonu için                                                      *
 *******************************************************************************/
#ifdef lcdprintf_aktif
void putch(unsigned char byte) {
    lcd_harfyaz(byte);
}
#endif